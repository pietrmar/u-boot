## board/streamunlimited/stream810/Kconfig
```kconfig
if TARGET_STREAM810

config SYS_BOARD
	default "stream810"

config SYS_VENDOR
	default "streamunlimited"

config SYS_SOC
	default "mx7"

config SYS_CONFIG_NAME
	default "stream810"

config USE_PLUGIN
	bool "Use plugin for memory detection"
	default "y"

endif
```

## board/streamunlimited/stream812/Kconfig
```kconfig
if TARGET_STREAM812

config SYS_BOARD
	default "stream812"

config SYS_VENDOR
	default "streamunlimited"

config SYS_SOC
	default "mx7"

config SYS_CONFIG_NAME
	default "stream812"

config USE_PLUGIN
	bool "Use plugin for memory detection"
	default "y"

endif
```

## configs/stream810_4Gb_defconfig
```kconfig
CONFIG_ARM=y
CONFIG_TARGET_STREAM810=y
CONFIG_DM=y
CONFIG_DEFAULT_DEVICE_TREE="s810"
CONFIG_SYS_EXTRA_OPTIONS="PHYS_SDRAM_SIZE=SZ_512M,IMX_CONFIG=board/streamunlimited/stream810/imximage_1x4Gb_ddr3.cfg,MX7D,TEE_RAM_SIZE=0x0400000,OPTEE_ENTRY=0x9fd00000"
CONFIG_CMD_MEMTEST=y
CONFIG_CMD_MEMINFO=y
CONFIG_OF_CONTROL=y
CONFIG_DM_THERMAL=y
```

## configs/stream810_defconfig
```kconfig
CONFIG_ARM=y
CONFIG_TARGET_STREAM810=y
CONFIG_DM=y
CONFIG_DEFAULT_DEVICE_TREE="s810"
CONFIG_SYS_EXTRA_OPTIONS="IMX_CONFIG=board/streamunlimited/stream810/imximage_32bit_ddr3.cfg,MX7D,SYS_BOOT_NAND"
CONFIG_CMD_MEMTEST=y
CONFIG_CMD_MEMINFO=y
CONFIG_OF_CONTROL=y
CONFIG_DM_THERMAL=y
```

## configs/stream810_static_1x2Gb_defconfig
```kconfig
CONFIG_ARM=y
CONFIG_TARGET_STREAM810=y
CONFIG_DM=y
# CONFIG_USE_PLUGIN is not set
CONFIG_DEFAULT_DEVICE_TREE="s810"
CONFIG_SYS_EXTRA_OPTIONS="PHYS_SDRAM_SIZE=SZ_256M,IMX_CONFIG=board/streamunlimited/stream810/imximage_1x2Gb_ddr3.cfg,MX7D,SYS_BOOT_NAND,TEE_RAM_SIZE=0x0400000,OPTEE_ENTRY=0x8fd00000"
CONFIG_CMD_MEMTEST=y
CONFIG_CMD_MEMINFO=y
CONFIG_OF_CONTROL=y
CONFIG_DM_THERMAL=y
```
